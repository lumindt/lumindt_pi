VERSION "1"

NS_ :

BS_:

BU_: BMS ECU

BO_ 800 M320: 8 BMS
 SG_ S1 : 7|8@0+ (1,0) [0|65.535] ""  ECU
 SG_ S2 : 8|8@0+ (1,0) [0|65.535] ""  ECU
 SG_ S3 : 16|8@0+ (1,0) [0|65.535] ""  ECU
 SG_ S4 : 24|8@0+ (1,0) [0|65.535] ""  ECU
 SG_ S5 : 32|8@0+ (1,0) [0|65.535] ""  ECU
 SG_ S6 : 40|8@0+ (1,0) [0|65.535] ""  ECU
 SG_ S7 : 48|8@0+ (1,0) [0|65.535] ""  ECU
 SG_ S8 : 56|8@0+ (1,0) [0|65.535] ""  ECU

BO_ 801 M321: 8 BMS
 SG_ S1 : 0|8@0+ (1,0) [0|65.535] ""  ECU
 SG_ S2 : 8|8@0+ (1,0) [0|65.535] ""  ECU
 SG_ S3 : 16|8@0+ (1,0) [0|65.535] ""  ECU
 SG_ S4 : 24|8@0+ (1,0) [0|65.535] ""  ECU
 SG_ S5 : 32|8@0+ (1,0) [0|65.535] ""  ECU
 SG_ S6 : 40|8@0+ (1,0) [0|65.535] ""  ECU
 SG_ S7 : 48|8@0+ (1,0) [0|65.535] ""  ECU
 SG_ S8 : 56|8@0+ (1,0) [0|65.535] ""  ECU

BO_ 802 M322: 8 BMS
 SG_ S1 : 0|8@0+ (1,0) [0|65.535] ""  ECU
 SG_ S2 : 8|8@0+ (1,0) [0|65.535] ""  ECU
 SG_ S3 : 16|8@0+ (1,0) [0|65.535] ""  ECU
 SG_ S4 : 24|8@0+ (1,0) [0|65.535] ""  ECU
 SG_ S5 : 32|8@0+ (1,0) [0|65.535] ""  ECU
 SG_ S6 : 40|8@0+ (1,0) [0|65.535] ""  ECU
 SG_ S7 : 48|8@0+ (1,0) [0|65.535] ""  ECU
 SG_ S8 : 56|8@0+ (1,0) [0|65.535] ""  ECU

BO_ 803 M323: 8 BMS
 SG_ S1 : 0|8@0+ (1,0) [0|65.535] ""  ECU
 SG_ S2 : 8|8@0+ (1,0) [0|65.535] ""  ECU
 SG_ S3 : 16|16@0+ (0.01,0) [0|65.535] ""  ECU
 SG_ S5 : 32|8@0+ (1,0) [0|65.535] ""  ECU
 SG_ S6 : 40|8@0+ (1,0) [0|65.535] ""  ECU
 SG_ S7 : 48|8@0+ (1,0) [0|65.535] ""  ECU
 SG_ S8 : 56|8@0+ (1,0) [0|65.535] ""  ECU

BO_ 804 M324: 8 BMS
 SG_ S1 : 0|16@0+ (0.1,0) [0|65.535] "C"  ECU
 SG_ S3 : 16|8@0+ (1,0) [0|65.535] ""  ECU
 SG_ S4 : 24|8@0+ (1,0) [0|65.535] ""  ECU
 SG_ S5 : 32|8@0+ (1,0) [0|65.535] ""  ECU
 SG_ S6 : 40|8@0+ (1,0) [0|65.535] ""  ECU
 SG_ S7 : 48|8@0+ (1,0) [0|65.535] ""  ECU
 SG_ S8 : 56|8@0+ (1,0) [0|65.535] ""  ECU

BO_ 805 M325: 8 BMS
 SG_ S1 : 0|8@0+ (1,0) [0|65.535] ""  ECU
 SG_ S2 : 8|8@0+ (1,0) [0|65.535] ""  ECU
 SG_ S3 : 16|8@0+ (1,0) [0|65.535] ""  ECU
 SG_ S4 : 24|8@0+ (1,0) [0|65.535] ""  ECU
 SG_ S5 : 32|8@0+ (1,0) [0|65.535] ""  ECU
 SG_ S6 : 40|8@0+ (1,0) [0|65.535] ""  ECU
 SG_ S7 : 48|8@0+ (1,0) [0|65.535] ""  ECU
 SG_ S8 : 56|8@0+ (1,0) [0|65.535] ""  ECU

BO_ 806 M326: 8 BMS
 SG_ S1 : 0|8@0+ (1,0) [0|65.535] ""  ECU
 SG_ S2 : 8|8@0+ (1,0) [0|65.535] ""  ECU
 SG_ S3 : 16|8@0+ (1,0) [0|65.535] ""  ECU
 SG_ S4 : 24|8@0+ (1,0) [0|65.535] ""  ECU
 SG_ S5 : 32|16@0+ (1,0) [0|65.535] ""  ECU
 SG_ S6 : 48|16@0+ (1,0) [0|65.535] ""  ECU

BO_ 807 M327: 8 BMS
 SG_ S1 : 0|8@0+ (1,0) [0|65.535] ""  ECU
 SG_ S2 : 8|8@0+ (1,0) [0|65.535] ""  ECU
 SG_ S3 : 16|8@0+ (1,0) [0|65.535] ""  ECU
 SG_ S4 : 24|8@0+ (1,0) [0|65.535] ""  ECU
 SG_ S5 : 32|8@0+ (1,0) [0|65.535] ""  ECU
 SG_ S6 : 40|8@0+ (1,0) [0|65.535] ""  ECU
 SG_ S7 : 48|8@0+ (1,0) [0|65.535] ""  ECU
 SG_ S8 : 56|8@0+ (1,0) [0|65.535] ""  ECU

BO_ 808 M328: 8 BMS
 SG_ S1 : 0|8@0+ (1,0) [0|65.535] ""  ECU
 SG_ S2 : 8|8@0+ (1,0) [0|65.535] ""  ECU
 SG_ S3 : 16|8@0+ (1,0) [0|65.535] ""  ECU
 SG_ S4 : 24|8@0+ (1,0) [0|65.535] ""  ECU
 SG_ S5 : 32|8@0+ (1,0) [0|65.535] ""  ECU
 SG_ S6 : 40|8@0+ (1,0) [0|65.535] ""  ECU
 SG_ S7 : 48|8@0+ (1,0) [0|65.535] ""  ECU
 SG_ S8 : 56|8@0+ (1,0) [0|65.535] ""  ECU

BO_ 809 M329: 8 BMS
 SG_ S1 : 0|8@0+ (1,0) [0|65.535] ""  ECU
 SG_ S2 : 8|8@0+ (1,0) [0|65.535] ""  ECU
 SG_ S3 : 16|8@0+ (1,0) [0|65.535] ""  ECU
 SG_ S4 : 24|8@0+ (1,0) [0|65.535] ""  ECU
 SG_ S5 : 32|8@0+ (1,0) [0|65.535] ""  ECU
 SG_ S6 : 40|8@0+ (1,0) [0|65.535] ""  ECU
 SG_ S7 : 48|8@0+ (1,0) [0|65.535] ""  ECU
 SG_ S8 : 56|8@0+ (1,0) [0|65.535] ""  ECU

BO_ 816 M330: 8 BMS
 SG_ S1 : 0|8@0+ (1,0) [0|65.535] ""  ECU
 SG_ S2 : 8|8@0+ (1,0) [0|65.535] ""  ECU
 SG_ S3 : 16|8@0+ (1,0) [0|65.535] ""  ECU
 SG_ S4 : 24|8@0+ (1,0) [0|65.535] ""  ECU
 SG_ S5 : 32|8@0+ (1,0) [0|65.535] ""  ECU
 SG_ S6 : 40|8@0+ (1,0) [0|65.535] ""  ECU
 SG_ S7 : 48|8@0+ (1,0) [0|65.535] ""  ECU
 SG_ S8 : 56|8@0+ (1,0) [0|65.535] ""  ECU

BO_ 817 M331: 8 BMS
 SG_ S1 : 0|8@0+ (1,0) [0|65.535] ""  ECU
 SG_ S2 : 8|8@0+ (1,0) [0|65.535] ""  ECU
 SG_ S3 : 16|8@0+ (1,0) [0|65.535] ""  ECU
 SG_ S4 : 24|8@0+ (1,0) [0|65.535] ""  ECU
 SG_ S5 : 32|8@0+ (1,0) [0|65.535] ""  ECU
 SG_ S6 : 40|8@0+ (1,0) [0|65.535] ""  ECU
 SG_ S7 : 48|8@0+ (1,0) [0|65.535] ""  ECU
 SG_ S8 : 56|8@0+ (1,0) [0|65.535] ""  ECU

BO_ 818 M332: 8 BMS
 SG_ S1 : 0|8@0+ (1,0) [0|65.535] ""  ECU
 SG_ S2 : 8|8@0+ (1,0) [0|65.535] ""  ECU
 SG_ S3 : 16|8@0+ (1,0) [0|65.535] ""  ECU
 SG_ S4 : 24|8@0+ (1,0) [0|65.535] ""  ECU
 SG_ S5 : 32|8@0+ (1,0) [0|65.535] ""  ECU
 SG_ S6 : 40|8@0+ (1,0) [0|65.535] ""  ECU
 SG_ S7 : 48|8@0+ (1,0) [0|65.535] ""  ECU
 SG_ S8 : 56|8@0+ (1,0) [0|65.535] ""  ECU

BO_ 819 M333: 5 BMS
 SG_ S1 : 0|8@0+ (1,0) [0|65.535] ""  ECU
 SG_ S2 : 8|8@0+ (1,0) [0|65.535] ""  ECU
 SG_ S3 : 16|8@0+ (1,0) [0|65.535] ""  ECU
 SG_ S4 : 24|8@0+ (1,0) [0|65.535] ""  ECU
 SG_ S5 : 32|8@0+ (1,0) [0|65.535] ""  ECU

BO_ 2508259072 Unknown: 2 BMS
 SG_ S1 : 0|8@0+ (1,0) [0|65.535] ""  ECU
 SG_ S2 : 8|8@0+ (1,0) [0|65.535] ""  ECU
